## common/Kconfig
```kconfig
#
# Copyright (c) 2020 Laird Connectivity
#
# SPDX-License-Identifier: Apache-2.0
#

menuconfig APPLICATION_COMMON
     bool "Config Common Application Modules"
	 default y

if APPLICATION_COMMON

config TEST_MENU
    bool "Enable test menu shell"
    depends on SHELL

config LOG_LEVEL_BLE_TASK
    int "Log level for BLE Msg Task"
    range 0 4
    default 3

config CONTROL_TASK_LOG_LEVEL
    int "Log level for Control Task"
    range 0 4
    default 3

config BSP_LOG_LEVEL
    int "Log level for BSP"
    range 0 4
    default 4

config SENSOR_TASK_LOG_LEVEL
    int "Log level for Sensor Task"
    range 0 4
    default 3
    
config ATTR_VALID_LOG_LEVEL
    int "Log level for Attribute Validator"
    range 0 4
    default 3

config AGGREGATION_LOG_LEVEL
    int "Log level for Aggregation Count"
    range 0 4
    default 3

config ADVERTISEMENT_LOG_LEVEL
    int "Log level for Advertisement"
    range 0 4
    default 3

config ALARM_CONTROL_LOG_LEVEL
    int "Log level for Alarm Control"
    range 0 4
    default 3

config EVENT_TASK_LOG_LEVEL
    int "Log level for Event Task"
    range 0 4
    default 3    

config ADVERTISEMENT_DISABLE
    bool "Disable advertisements for easier debug"
    help
        For a peripheral breakpoints can be used if advertisements aren't started.
        This is easier than setting CONFIG_BT=n because msg framework assertions can
        remain on.

config SETTINGS_MOUNT_POINT
    string "The mount point for settings (storage partition in internal flash)"
    default "/lfs"

config MCUMGR_CMD_SENTRIUS_MGMT
    bool "Enable the Sentrius mcumgr interface"
    depends on MCUMGR
    default y

config HEARTBEAT_SECONDS
    int "Heartbeat tick rate seconds"
    range 1 3600
    default 60
    help
        Update rate for increasing battery age counter and qrtc in attributes.

rsource "Kconfig.adc_bt6"
rsource "Kconfig.attribute"
rsource "Kconfig.ui"
rsource "Kconfig.event_log"

endif # APPLICATION_COMMON
```

## common/Kconfig.attribute
```kconfig
#
# Copyright (c) 2020 Laird Connectivity
#
# SPDX-License-Identifier: Apache-2.0
#

config ATTR_LOG_LEVEL
    int "Log level for Attributes module"
    range 0 4
    default 3

config ATTR_FILE_NAME
    string "File name for attributes"
    default "attr.txt"

config ATTR_BREAK_ON_LOAD_FAILURE
    bool "Stop loading on first failure"

config ATTR_SHELL
    bool "Enable Attribute Shell"
    depends on SHELL
    depends on FILE_SYSTEM_UTILITIES
    depends on ATTR_LOG_LEVEL > 3
    depends on FRAMEWORK

config ATTR_SHELL_SHOW_ALL_DELAY_MS
    int "Amount of time to delay between each debug log print"
    depends on ATTR_SHELL
    default 10
    help
        This is used to prevent log system overflow.

config ATTR_SHOW_FMT
    string "Format for the attribute show command index name"
    default "[%03u] %-30s"

config ATTR_FLOAT_FMT
    string "Default format for floats"
    default "%.4e"

config ATTR_FLOAT_MAX_STR_SIZE
    int "Number of characters (and NULL) for floats converted to string using"
    default 13
    help
         An example with ATTR_FLOAT_FMT of %0.4e is -2.8171e+000.
```

## common/Kconfig.event_log
```kconfig
#
# Copyright (c) 2020 Laird Connectivity
#
# SPDX-License-Identifier: Apache-2.0
#

config EVENT_LOG
    bool "Enable Enable Log"
    default y

config EVENT_LOG_LEVEL
    int "Log level Event Log module"
    range 0 4
    default 3

config EVENT_LOG_MAX_COUNT
    int "Maximum number of event logs"
    default 16

config EVENT_LOG_MAX_SIZE
    int "Maximum number of bytes for log"
    default 16384
```

## common/Kconfig.ui
```kconfig
#
# Copyright (c) 2020 Laird Connectivity
#
# SPDX-License-Identifier: Apache-2.0
#

config UI_TASK_LOG_LEVEL
    int "Log level for BLE Msg Task"
    range 0 4
    default 3

config UI_LED_TEST_ON_RESET
    bool "Light LEDs after reset using test pattern"

config UI_LED_TEST_ON_RESET_DURATION_MS
    int "Time in ms for each step"
    depends on UI_LED_TEST_ON_RESET
    default 1000

#
# Non-customizable items
#
config UI_NUMBER_OF_BUTTONS
    int
    default 3

config UI_PAIR_MIN_MS
    int
    default 3000
    help
        Pairing request means start advertising
        Applies to SW1 and SW3 (AMR)

config UI_PAIR_MAX_MS
    int
    default 10000

config UI_MAX_ALIVE_MS
    int
    default 1000

config UI_MIN_FACTORY_RESET_MS
    int
    default 10000

config UI_MAX_FACTORY_RESET_MS
    int
    default 20000
```

## peripheral_IO/Kconfig
```kconfig
# Copyright (c) 2020 Laird Connectivity
# SPDX-License-Identifier: Apache-2.0

menuconfig USER_APPLICATION
     bool "Config User Application"
	 default y

if USER_APPLICATION

config LAIRD_CONNECTIVITY_DEBUG
    bool
    default n

config JSON_BRACKET_BUFFER_SIZE
    int "The maximum size JSON message that can be processed"
    default 1536
    help
        This applies to sensor messages received over Bluetooth.

config ATTR_SAVE_DELAY_MS
    int "Time (in ms) before saving attributes to filesystem to cache other data to write"
    default 30000
    range 1000 3600000

config UART_SHUTOFF
    bool "Enables shutting the main UART off to conserve power"
    default y

config FILE_ACCESS_LOG_LEVEL
    int "File access log level for reading/writing files over SMP"
    range 0 4
    default 0

config RECOVERY_FILE_PATH
    string "File name (including path) of where the recovery count file is stored"
    default "/lfs/recovery_count"

config ATTR_SHELL_ALLOW_DEBUG_COMMANDS
    bool "Enables shell functions that can modify, dump and load data"
    help
        This should not be enabled for production builds.

menuconfig MINIMUM_FIRMWARE_VERSION_FOTA_CHECK
    bool "Enable minimum firmware version FOTA check"
    default n

config MINIMUM_FIRMWARE_VERSION_MAJOR
    int "Major firmware version (a.x.x) which is the minimum allowed for FOTA"
    range 0 255
    default 1
    depends on MINIMUM_FIRMWARE_VERSION_FOTA_CHECK

config MINIMUM_FIRMWARE_VERSION_MINOR
    int "Minor firmware version (x.b.x) which is the minimum allowed for FOTA"
    range 0 255
    default 28
    depends on MINIMUM_FIRMWARE_VERSION_FOTA_CHECK

config MINIMUM_FIRMWARE_VERSION_REVISION
    int "Revision firmware version (x.x.c) which is the minimum allowed for FOTA"
    range 0 65535
    default 0
    depends on MINIMUM_FIRMWARE_VERSION_FOTA_CHECK

config MAX_SETTINGS_FILE_SIZE
    int "Maximum size of settings file before removing to save space"
    range 0 4096
    default 1024
    depends on SETTINGS_FS
    help
        A setting of 0 will not purge the file, purge size must be greater than
	256 to be valid.

menuconfig WDT
    bool "Config Watchdog Timer"
    imply WATCHDOG
    default y
    help
        Enable-to-Disable requires power cycle or watchdog reset.
        Watchdog cannot be stopped once started.
        It can be reconfigured after a reset.
        If a watchdog reset occurs, then it won't cause another
        reset unless it is re-enabled.

if WDT

config WDT_INIT_PRIORITY
    int "System init priority (Application)"
    default 0

config WDT_LOG_LEVEL
    int "Log level for BLE watchdog module"
    range 0 4
    default 3

config WDT_TIMEOUT_MILLISECONDS
    int "Rate in milliseconds for watchdog"
    range 18000 1200000
    default 600000
    help
        Default timeout is 10 minutes

config WDT_WORK_QUEUE_STACK_SIZE
    int
    default 320

config WDT_TEST
    bool "Force the watchdog to timeout (set during initialization)"

endif # WDT

endif # USER_APPLICATION

rsource "../common/Kconfig"

source "Kconfig.zephyr"
```

## src/Kconfig.adc_bt6
```kconfig
#
# Copyright (c) 2020 Laird Connectivity
#
# SPDX-License-Identifier: Apache-2.0
#

config ADC_BT6
    bool "Enable BT6 ADC Module"
    depends on ADC_NRFX_SAADC
    depends on ADC_CONFIGURABLE_INPUTS
    default y

config ADC_BT6_LOG_LEVEL
    int "Log level for BT6xx ADC module"
    range 0 4
    default 3

config ADC_BT6_OVERSAMPLING
    int "(2**THIS_VALUE samples to average for each ADC reading"
    range 0 8
    default 4

config ADC_BT6_THERMISTOR_CALIBRATION_SAMPLES
    int "Number of samples to average when calibrating thermistor inputs"
    range 1 128
    default 32
```
