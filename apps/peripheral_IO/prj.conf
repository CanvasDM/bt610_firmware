## CMakeLists.txt
```
cmake_minimum_required(VERSION 3.13.1)
find_package(Zephyr REQUIRED HINTS $ENV{ZEPHYR_BASE})
project(peripheral_hids)

FILE(GLOB app_sources src/*.c)
target_sources(app PRIVATE ${app_sources})
zephyr_include_directories(${ZEPHYR_BASE}/include/power)
zephyr_include_directories(${ZEPHYR_BASE}/include/drivers)
include_directories(${CMAKE_SOURCE_DIR}/include)

#target_include_directories(TINYCBOR INTERFACE include/tinycbor)
#target_include_directories(TINYCBOR INTERFACE include)

#FILE(GLOB cbor_sources ./../../modules/lib/tinycbor/src/*.c)
#target_sources(app PRIVATE ${cbor_sources})
#include_directories(${CMAKE_SOURCE_DIR}/../../modules/lib/tinycbor/include/tinycbor)

FILE(GLOB fwk_sources ./../../modules/framework/source/*.c)
target_sources(app PRIVATE ${fwk_sources})
include_directories(${CMAKE_SOURCE_DIR}/../../modules/framework/include)
include_directories(${CMAKE_SOURCE_DIR}/framework_config)
```

## Kconfig
```
# Copyright (c) 2020 Laird Connectivity
# SPDX-License-Identifier: Apache-2.0


menuconfig USER_APPLICATION
     bool "Config User Application"
	 default y

if USER_APPLICATION

config LAIRD_CONNECTIVITY_DEBUG
    bool
    default n
	
config JSON_BRACKET_BUFFER_SIZE
    int "The maximum size JSON message that can be processed"
    default 1536
    help
        This applies to sensor messages received over Bluetooth.


config JSON_LOG_ENABLED
    bool "Print JSON messages in task context using printk"

config JSON_LOG_PUBLISH
    bool "Print data published to AWS"

config JSON_LOG_TOPIC
    bool "Print the topic that documents are published to or received from"

config JSON_LOG_MQTT_RX_DATA
    bool "Enable/Disable printing of received MQTT data."


config BT_SCAN_MAX_USERS
	int "Maximum number of users of the scan module"
	range 1 32
	default 2

config BT_SCAN_VERBOSE_ADV_HANDLER
	bool "Enable Verbose logging of advertisements"

endif # USER_APPLICATION

source "../modules/framework/Kconfig"
source "../component_lib/Kconfig"

source "Kconfig.zephyr"
```

## prj.conf
```kconfig
# Incresed stack due to settings API usage
CONFIG_SYSTEM_WORKQUEUE_STACK_SIZE=2048
CONFIG_HEAP_MEM_POOL_SIZE=4096

CONFIG_BT=y
CONFIG_BT_DEBUG_LOG=y
CONFIG_BT_SMP=y
CONFIG_BT_PERIPHERAL=y
CONFIG_BT_GATT_DIS=y
CONFIG_BT_GATT_BAS=y
CONFIG_BT_DEVICE_NAME="BT6_Sensor"
CONFIG_BT_DEVICE_APPEARANCE=962
CONFIG_BT_SETTINGS=y

CONFIG_GPIO=y
CONFIG_I2C=y

# PWM
CONFIG_PWM=y
CONFIG_PWM_LOG_LEVEL_DBG=y

CONFIG_FLASH=y
CONFIG_FLASH_PAGE_LAYOUT=y
CONFIG_FLASH_MAP=y

CONFIG_NVS=y

CONFIG_SETTINGS=y

CONFIG_REBOOT=y

CONFIG_TINYCBOR=y
CONFIG_NEWLIB_LIBC=y 

CONFIG_ADC=y
CONFIG_ADC_ASYNC=y
CONFIG_ADC_NRFX_SAADC=y
#CONFIG_ADC_CONFIGURABLE_INPUTS=y

#Console
CONFIG_CONSOLE=y
#CONFIG_UART_CONSOLE=n
CONFIG_USE_SEGGER_RTT=y
CONFIG_RTT_CONSOLE=y

CONFIG_SERIAL=y
CONFIG_UART_INTERRUPT_DRIVEN=y

# command line shell
CONFIG_SHELL=y
CONFIG_KERNEL_SHELL=y
CONFIG_DEVICE_SHELL=y

CONFIG_COMPONENT_LIB=y

# Message Framework
CONFIG_FWK_ASSERT_ENABLED=y
CONFIG_BUFFER_POOL_SIZE=32768
CONFIG_REBOOT=y

# Enable the LittleFS file system.
CONFIG_FILE_SYSTEM=y
CONFIG_FILE_SYSTEM_LITTLEFS=y
 
# Enable mcumgr to support FOTA
CONFIG_MCUMGR=y
CONFIG_MCUMGR_SMP_SHELL=y
CONFIG_MCUMGR_SMP_SHELL_MTU=2048
CONFIG_MCUMGR_BUF_SIZE=2050
CONFIG_MGMT_CBORATTR_MAX_SIZE=2048
CONFIG_FS_MGMT_UL_CHUNK_SIZE=2048
# Enable the Bluetooth (unauthenticated) mcumgr transport.
CONFIG_MCUMGR_SMP_BT=y
CONFIG_MCUMGR_SMP_BT_AUTHEN=n
 
CONFIG_MCUMGR_CMD_IMG_MGMT=y
CONFIG_MCUMGR_CMD_OS_MGMT=y
CONFIG_MCUMGR_CMD_FS_MGMT=y
#CONFIG_MCUMGR_CMD_SENTRIUS_MGMT=y
# Enable large files at the expense of larger CBOR encoding.
CONFIG_FS_MGMT_MAX_FILE_SIZE_4GB=y
```

## src/main.c
```c
/* main.c - Application main entry point */

/*
 * Copyright (c) 2019 Laird Connectivity
 *
 * SPDX-License-Identifier: Apache-2.0
 */
#include "FrameworkIncludes.h"
#include "ControlTask.h"
#include "BspSupport.h"

void main(void)
{
	BSP_Init();
	Framework_Initialize();

	ControlTask_Initialize();
	ControlTask_Thread();
}
```

## include/AdcRead.h
```c
/**
 * @file AdcRead.h
 * @brief
 *
 * Copyright (c) 2020 Laird Connectivity
 *
 * SPDX-License-Identifier: Apache-2.0
 */
#ifndef __ADC_READ_H__
#define __ADC_READ_H__

/* (Remove Empty Sections) */
/******************************************************************************/
/* Includes                                                                   */
/******************************************************************************/
#include <zephyr/types.h>
#include <stddef.h>

#ifdef __cplusplus
extern "C" {
#endif

/******************************************************************************/
/* Global Constants, Macros and Type Definitions                              */
/******************************************************************************/
typedef enum
{
	BATTERY_ADC_CH = 0,
	ANALOG_SENSOR_1_CH,
	THERMISTOR_SENSOR_2_CH,
	ADC_3_CH,
	ADC_4_CH,
	VREF_5_CH,
}AnalogTypesChannel_t;

/******************************************************************************/
/* Global Data Definitions                                                    */
/******************************************************************************/

/******************************************************************************/
/* Global Function Prototypes                                                 */
/******************************************************************************/
/**
 * @brief
 *
 * @param
 * @param
 *
 * @retval
 */

uint32_t AnalogRead(AnalogTypesChannel_t channelReading);
uint32_t ADC_GetBatteryMv(void);
#ifdef __cplusplus
}
#endif

#endif /* __TEMPLATE_H__ */
```

## include/AnalogSensorTask.h
```c
/**
 * @file AnalogSensorTask.h
 * @brief
 *
 * Copyright (c) 2020 Laird Connectivity
 *
 * SPDX-License-Identifier: Apache-2.0
 */
#ifndef __ANALOG_SENSOR_TASK_H__
#define __ANALOG_SENSOR_TASK_H__

/* (Remove Empty Sections) */
/******************************************************************************/
/* Includes                                                                   */
/******************************************************************************/
#include <zephyr/types.h>
#include <stddef.h>

#ifdef __cplusplus
extern "C" {
#endif

/******************************************************************************/
/* Global Constants, Macros and Type Definitions                              */
/******************************************************************************/

/******************************************************************************/
/* Global Data Definitions                                                    */
/******************************************************************************/

/******************************************************************************/
/* Global Function Prototypes                                                 */
/******************************************************************************/
/**
 * @brief
 *
 * @param
 * @param
 *
 * @retval
 */
void AnalogSensorTask_Initialize(void);

#ifdef __cplusplus
}
#endif

#endif /* __ANALOG_SENSOR_TASK_H__ */
```

## include/AttributeFunctions.h
```c
/******************************************************************************/
//!
//! @file AttributeFunctions.h
//!
//! @brief Attribute function indices
//!
//! @note psysart to pyend regions are generated by parmGenorator.py.
//!
//! Copyright (c) 2020 Laird Connectivity
//! All Rights Reserved.
/******************************************************************************/

#ifndef ATTRIBUTE_FUNCTIONS_H
#define ATTRIBUTE_FUNCTIONS_H

#ifdef __cplusplus
extern "C" {
#endif

/******************************************************************************/
/* Includes                                                                   */
/******************************************************************************/

/******************************************************************************/
/* Global Constants, Macros and Type Definitions                              */
/******************************************************************************/

// pystart - attribute function definitions
#define ATTRIBUTE_FUNCTION_TABLE_SIZE 108

#define ATTRIBUTE_TOTAL_KEYWORDS 79
// pyend

/******************************************************************************/
/* Message Indices                                                            */
/******************************************************************************/
//
// These don't follow the naming convention. The names match the documentation.
//
// pystart - attribute function indices
#define ATTR_INDEX_SetSensorName                         1
#define ATTR_INDEX_SetSensorLocation                     2
#define ATTR_INDEX_SetBLEAdvertisingInterval             3
#define ATTR_INDEX_SetBLEAdvertisingDuration             4
#define ATTR_INDEX_SetBLEPasskey                         5
#define ATTR_INDEX_SetSettingsLock                       6
#define ATTR_INDEX_SetBatterySenseInterval               7
#define ATTR_INDEX_SetTemperatureSenseInterval           8
#define ATTR_INDEX_SetTemperatureAggregationValue        9
#define ATTR_INDEX_SetDigitalOutput1                     10
#define ATTR_INDEX_SetDigitalOutput2                     11
#define ATTR_INDEX_SetDigitalInput1                      12
#define ATTR_INDEX_SetDigitalInput2                      13
#define ATTR_INDEX_SetAnalogInputType                    14
#define ATTR_INDEX_SetTemperature1AlarmThreshold         15
#define ATTR_INDEX_SetTemperature2AlarmThreshold         16
#define ATTR_INDEX_SetTemperature3AlarmThreshold         17
#define ATTR_INDEX_SetTemperature4AlarmThreshold         18
#define ATTR_INDEX_SetAnalog1AlarmThresholds             19
#define ATTR_INDEX_SetAnalog2AlarmThresholds             20
#define ATTR_INDEX_SetAnalog3AlarmThresholds             21
#define ATTR_INDEX_SetAnalog4AlarmThresholds             22
#define ATTR_INDEX_SetActiveMode                         23
#define ATTR_INDEX_SetUseCodedPhy                        24
#define ATTR_INDEX_SetTxPower                            25
#define ATTR_INDEX_SetNetworkId                          26
#define ATTR_INDEX_SetConfigVersion                      27
#define ATTR_INDEX_SetHardwareVersion                    28
#define ATTR_INDEX_SetLedTest                            29
#define ATTR_INDEX_GetAllTemperature                     30
#define ATTR_INDEX_GetTemperature1                       31
#define ATTR_INDEX_GetTemperature2                       32
#define ATTR_INDEX_GetTemperature3                       33
#define ATTR_INDEX_GetTemperature4                       34
#define ATTR_INDEX_GetCurrent                            35
#define ATTR_INDEX_GetBatteryVoltage                     36
#define ATTR_INDEX_GetDigitalInputAlarms                 37
#define ATTR_INDEX_GetTemperature1Alarms                 38
#define ATTR_INDEX_GetTemperature2Alarms                 39
#define ATTR_INDEX_GetTemperature3Alarms                 40
#define ATTR_INDEX_GetTemperature4Alarms                 41
#define ATTR_INDEX_GetAnalog1Alarms                      42
#define ATTR_INDEX_GetAnalog2Alarms                      43
#define ATTR_INDEX_GetAnalog3Alarms                      44
#define ATTR_INDEX_GetAnalog4Alarms                      45
#define ATTR_INDEX_GetHardwareVersion                    46
#define ATTR_INDEX_GetFirmwareVersion                    47
#define ATTR_INDEX_GetResetReason                        48
#define ATTR_INDEX_GetBluetoothMAC                       49
#define ATTR_INDEX_GetBluetoothMTU                       50
#define ATTR_INDEX_GetFlags                              51
#define ATTR_INDEX_GetResetCount                         52
#define ATTR_INDEX_GetSensorName                         53
#define ATTR_INDEX_GetSensorLocation                     54
#define ATTR_INDEX_GetBLEAdvertisingInterval             55
#define ATTR_INDEX_GetBLEAdvertisingDuration             56
#define ATTR_INDEX_GetSettingsLock                       57
#define ATTR_INDEX_GetBatterySenseInterval               58
#define ATTR_INDEX_GetTemperatureSenseInterval           59
#define ATTR_INDEX_GetTemperatureAggregationValue        60
#define ATTR_INDEX_GetDigitalOutput1                     61
#define ATTR_INDEX_GetDigitalOutput2                     62
#define ATTR_INDEX_GetDigitalInput1                      63
#define ATTR_INDEX_GetDigitalInput2                      64
#define ATTR_INDEX_GetAnalogInput1Type                   65
#define ATTR_INDEX_GetTemperature1AlarmThreshold         66
#define ATTR_INDEX_GetTemperature2AlarmThreshold         67
#define ATTR_INDEX_GetTemperature3AlarmThreshold         68
#define ATTR_INDEX_GetTemperature4AlarmThreshold         69
#define ATTR_INDEX_GetAnalog1AlarmThresholds             70
#define ATTR_INDEX_GetAnalog2AlarmThresholds             71
#define ATTR_INDEX_GetAnalog3AlarmThresholds             72
#define ATTR_INDEX_GetAnalog4AlarmThresholds             73
#define ATTR_INDEX_GetActiveMode                         74
#define ATTR_INDEX_GetUseCodedPhy                        75
#define ATTR_INDEX_GetTxPower                            76
#define ATTR_INDEX_GetNetworkId                          77
#define ATTR_INDEX_GetConfigVersion                      78
#define ATTR_INDEX_GetMagnetState                        79
// pyend

/******************************************************************************/
/* Global Data Definitions                                                    */
/******************************************************************************/

/******************************************************************************/
/* Global Function Prototypes                                                 */
/******************************************************************************/

#ifdef __cplusplus
}
#endif

#endif //END ATTRIBUTE_FUNCTIONS_H
```

## include/BT610_mgmt.h
```c
/*
 * Licensed to the Apache Software Foundation (ASF) under one
 * or more contributor license agreements.  See the NOTICE file
 * distributed with this work for additional information
 * regarding copyright ownership.  The ASF licenses this file
 * to you under the Apache License, Version 2.0 (the
 * "License"); you may not use this file except in compliance
 * with the License.  You may obtain a copy of the License at
 *
 *  http://www.apache.org/licenses/LICENSE-2.0
 *
 * Unless required by applicable law or agreed to in writing,
 * software distributed under the License is distributed on an
 * "AS IS" BASIS, WITHOUT WARRANTIES OR CONDITIONS OF ANY
 * KIND, either express or implied.  See the License for the
 * specific language governing permissions and limitations
 * under the License.
 */

#ifndef H_FS_MGMT_
#define H_FS_MGMT_

#ifdef __cplusplus
extern "C" {
#endif

/**
 * Command IDs for file system management group.
 */
// pystart - mgmt function indices
#define BT610_MGMT_ID_SETSENSORNAME                         1
#define BT610_MGMT_ID_SETSENSORLOCATION                     2
#define BT610_MGMT_ID_SETBLEADVERTISINGINTERVAL             3
#define BT610_MGMT_ID_SETBLEADVERTISINGDURATION             4
#define BT610_MGMT_ID_SETBLEPASSKEY                         5
#define BT610_MGMT_ID_SETSETTINGSLOCK                       6
#define BT610_MGMT_ID_SETBATTERYSENSEINTERVAL               7
#define BT610_MGMT_ID_SETTEMPERATURESENSEINTERVAL           8
#define BT610_MGMT_ID_SETTEMPERATUREAGGREGATIONVALUE        9
#define BT610_MGMT_ID_SETDIGITALOUTPUT1                     10
#define BT610_MGMT_ID_SETDIGITALOUTPUT2                     11
#define BT610_MGMT_ID_SETDIGITALINPUT1                      12
#define BT610_MGMT_ID_SETDIGITALINPUT2                      13
#define BT610_MGMT_ID_SETANALOGINPUTTYPE                    14
#define BT610_MGMT_ID_SETTEMPERATURE1ALARMTHRESHOLD         15
#define BT610_MGMT_ID_SETTEMPERATURE2ALARMTHRESHOLD         16
#define BT610_MGMT_ID_SETTEMPERATURE3ALARMTHRESHOLD         17
#define BT610_MGMT_ID_SETTEMPERATURE4ALARMTHRESHOLD         18
#define BT610_MGMT_ID_SETANALOG1ALARMTHRESHOLDS             19
#define BT610_MGMT_ID_SETANALOG2ALARMTHRESHOLDS             20
#define BT610_MGMT_ID_SETANALOG3ALARMTHRESHOLDS             21
#define BT610_MGMT_ID_SETANALOG4ALARMTHRESHOLDS             22
#define BT610_MGMT_ID_SETACTIVEMODE                         23
#define BT610_MGMT_ID_SETUSECODEDPHY                        24
#define BT610_MGMT_ID_SETTXPOWER                            25
#define BT610_MGMT_ID_SETNETWORKID                          26
#define BT610_MGMT_ID_SETCONFIGVERSION                      27
#define BT610_MGMT_ID_SETHARDWAREVERSION                    28
#define BT610_MGMT_ID_SETLEDTEST                            29
#define BT610_MGMT_ID_GETALLTEMPERATURE                     30
#define BT610_MGMT_ID_GETTEMPERATURE1                       31
#define BT610_MGMT_ID_GETTEMPERATURE2                       32
#define BT610_MGMT_ID_GETTEMPERATURE3                       33
#define BT610_MGMT_ID_GETTEMPERATURE4                       34
#define BT610_MGMT_ID_GETCURRENT                            35
#define BT610_MGMT_ID_GETBATTERYVOLTAGE                     36
#define BT610_MGMT_ID_GETDIGITALINPUTALARMS                 37
#define BT610_MGMT_ID_GETTEMPERATURE1ALARMS                 38
#define BT610_MGMT_ID_GETTEMPERATURE2ALARMS                 39
#define BT610_MGMT_ID_GETTEMPERATURE3ALARMS                 40
#define BT610_MGMT_ID_GETTEMPERATURE4ALARMS                 41
#define BT610_MGMT_ID_GETANALOG1ALARMS                      42
#define BT610_MGMT_ID_GETANALOG2ALARMS                      43
#define BT610_MGMT_ID_GETANALOG3ALARMS                      44
#define BT610_MGMT_ID_GETANALOG4ALARMS                      45
#define BT610_MGMT_ID_GETHARDWAREVERSION                    46
#define BT610_MGMT_ID_GETFIRMWAREVERSION                    47
#define BT610_MGMT_ID_GETRESETREASON                        48
#define BT610_MGMT_ID_GETBLUETOOTHMAC                       49
#define BT610_MGMT_ID_GETBLUETOOTHMTU                       50
#define BT610_MGMT_ID_GETFLAGS                              51
#define BT610_MGMT_ID_GETRESETCOUNT                         52
#define BT610_MGMT_ID_GETSENSORNAME                         53
#define BT610_MGMT_ID_GETSENSORLOCATION                     54
#define BT610_MGMT_ID_GETBLEADVERTISINGINTERVAL             55
#define BT610_MGMT_ID_GETBLEADVERTISINGDURATION             56
#define BT610_MGMT_ID_GETSETTINGSLOCK                       57
#define BT610_MGMT_ID_GETBATTERYSENSEINTERVAL               58
#define BT610_MGMT_ID_GETTEMPERATURESENSEINTERVAL           59
#define BT610_MGMT_ID_GETTEMPERATUREAGGREGATIONVALUE        60
#define BT610_MGMT_ID_GETDIGITALOUTPUT1                     61
#define BT610_MGMT_ID_GETDIGITALOUTPUT2                     62
#define BT610_MGMT_ID_GETDIGITALINPUT1                      63
#define BT610_MGMT_ID_GETDIGITALINPUT2                      64
#define BT610_MGMT_ID_GETANALOGINPUT1TYPE                   65
#define BT610_MGMT_ID_GETTEMPERATURE1ALARMTHRESHOLD         66
#define BT610_MGMT_ID_GETTEMPERATURE2ALARMTHRESHOLD         67
#define BT610_MGMT_ID_GETTEMPERATURE3ALARMTHRESHOLD         68
#define BT610_MGMT_ID_GETTEMPERATURE4ALARMTHRESHOLD         69
#define BT610_MGMT_ID_GETANALOG1ALARMTHRESHOLDS             70
#define BT610_MGMT_ID_GETANALOG2ALARMTHRESHOLDS             71
#define BT610_MGMT_ID_GETANALOG3ALARMTHRESHOLDS             72
#define BT610_MGMT_ID_GETANALOG4ALARMTHRESHOLDS             73
#define BT610_MGMT_ID_GETACTIVEMODE                         74
#define BT610_MGMT_ID_GETUSECODEDPHY                        75
#define BT610_MGMT_ID_GETTXPOWER                            76
#define BT610_MGMT_ID_GETNETWORKID                          77
#define BT610_MGMT_ID_GETCONFIGVERSION                      78
#define BT610_MGMT_ID_GETMAGNETSTATE                        79
// pyend

/**
 * @brief Registers the file system management command handler group.
 */ 
void bt610_mgmt_register_group(void);

#ifdef __cplusplus
}
#endif

#endif
```

## include/BleTask.h
```c
/**
 * @file BleTask.h
 * @brief
 *
 * Copyright (c) 2020 Laird Connectivity
 *
 * SPDX-License-Identifier: Apache-2.0
 */
#ifndef __TEMPLATE_H__
#define __TEMPLATE_H__

/* (Remove Empty Sections) */
/******************************************************************************/
/* Includes                                                                   */
/******************************************************************************/
#include <zephyr/types.h>
#include <stddef.h>

#ifdef __cplusplus
extern "C" {
#endif

/******************************************************************************/
/* Global Constants, Macros and Type Definitions                              */
/******************************************************************************/

/******************************************************************************/
/* Global Data Definitions                                                    */
/******************************************************************************/

/******************************************************************************/
/* Global Function Prototypes                                                 */
/******************************************************************************/
/**
 * @brief
 *
 * @param
 * @param
 *
 * @retval
 */
void BleTask_Initialize(void);

#ifdef __cplusplus
}
#endif

#endif /* __TEMPLATE_H__ */
```

## include/Bracket.h
```c
/**
 * @file Bracket.h
 * @brief Handles bracket matching on a JSON serial stream.
 * A packet framer and rudimentary parser.
 *
 * Copyright (c) 2020 Laird Connectivity
 *
 * SPDX-License-Identifier: Apache-2.0
 */
#ifndef __BRACKET_H__
#define __BRACKET_H__

#ifdef __cplusplus
extern "C" {
#endif

/******************************************************************************/
/* Includes                                                                   */
/******************************************************************************/
#include <zephyr/types.h>
#include <stddef.h>
#include<kernel.h>

/******************************************************************************/
/* Global Constants, Macros and Type Definitions                              */
/******************************************************************************/
#define BRACKET_MATCH 0
#define BRACKET_MATCHING_NOT_STARTED 1

typedef struct BracketObject BracketObj_t;

/******************************************************************************/
/* Global Function Prototypes                                                 */
/******************************************************************************/
/**
 * @brief Allocates memory for and initializes a bracket handler.
 *
 * @param Size of the buffer
 *
 * @retval pointer to bracket object
 */
BracketObj_t *Bracket_Initialize(size_t Size);

/**
 * @brief Resets bracket (delta and index).
 *
 * @param p is a pointer to bracket object
 */
void Bracket_Reset(BracketObj_t *p);

/**
 * @brief Accessor Function
 *
 * @param p is a pointer to bracket object
 *
 * @retval true if bracket delta is 0, false otherwise
 */
bool Bracket_Match(BracketObj_t *p);

/**
 * @brief Accessor Function
 *
 * @param p is a pointer to bracket object
 *
 * @retval true if the first '{' has been found after bracket was reset.
 */
bool Bracket_Entered(BracketObj_t *p);

/**
 * @brief Accessor Function
 *
 * @param p is a pointer to bracket object
 *
 * @retval the number of used bytes in the bracket.
 */
size_t Bracket_Length(BracketObj_t *p);

/**
 * @brief Accessor Function
 *
 * @param p is a pointer to bracket object
 *
 * @retval the total number of bytes in the bracket.
 */
size_t Bracket_Size(BracketObj_t *p);

/**
 * @brief Counts the number of { } matching pairs in a JSON stream.
 * If the first bracket has been found then the character is added to the
 * buffer.
 *
 * @param p is a pointer to bracket object
 * @param Character is the next character to process.
 *
 * @retval 0 for bracket match (at least one '{' was found).
 * @retval > 0 the delta between { and }. This will be 1 if first '{'
 * hasn't been found.
 * @retval -ENOMEM if there wasn't enough memory to process incoming stream
 */
int Bracket_Compute(BracketObj_t *p, char Character);

/**
 * @brief Copies the current buffer into the destination (pDest) if non-NULL.
 *
 * @param pDest if NULL, then nothing is copied but length is still valid.
 *
 * @retval The number of bytes in the buffer (length).
 */
size_t Bracket_Copy(BracketObj_t *p, void *pDest);

#ifdef __cplusplus
}
#endif

#endif /* __BRACKET_H__ */
```

## include/BspSupport.h
```c
/**
 * @file BspSupport.h
 * @brief
 *
 * Copyright (c) 2020 Laird Connectivity
 *
 * SPDX-License-Identifier: Apache-2.0
 */
#ifndef __BSP_SUPPORT_H__
#define __BSP_SUPPORT_H__

/* (Remove Empty Sections) */
/******************************************************************************/
/* Includes                                                                   */
/******************************************************************************/
#include <zephyr/types.h>
#include <stddef.h>

#ifdef __cplusplus
extern "C" {
#endif

/******************************************************************************/
/* Global Constants, Macros and Type Definitions                              */
/******************************************************************************/
#define UART_DEVICE_NAME DT_LABEL(DT_NODELABEL(uart0))

//***Inputs*****
#define DIN1_MCU_PIN               (9) //SIO_09 Port0
#define DIN2_MCU_PIN               (43)//SIO_43 Port1
#define UART_RXD_PIN               (6)//SIO_06 Port0

//***Output*****
//PORT0
#define THERM_ENABLE_PIN           (10)//SIO_10 Port0
#define DO2_PIN                    (11)//SIO_11 Port0
#define DO1_PIN                    (12)//SIO_12 Port0
#define BATT_OUT_ENABLE_PIN        (30)//SIO_30 Port0
//PORT1
#define DIN1_ENABLE_PIN            (37)//SIO_37 Port1
#define FIVE_VOLT_ENABLE_PIN       (44)//SIO_44 Port1
#define DIN2_ENABLE_PIN            (42)//SIO_42 Port1
#define ANALOG_ENABLE_PIN          (45)//SIO_45 Port1

#define GPIO_PIN_MAP(p)           ((p>32)?(p-32):p)

/******************************************************************************/
/* Global Data Definitions                                                    */
/******************************************************************************/

/******************************************************************************/
/* Global Function Prototypes                                                 */
/******************************************************************************/
/**
 * @brief
 *
 * @param
 * @param
 *
 * @retval
 */
void BSP_Init(void);
uint16_t BSP_PinSet(uint8_t pin, uint16_t value);
uint16_t BSP_PinToggle(uint8_t pin);
uint16_t BSP_PinGet(uint8_t pin, uint16_t value);
void BSP_ConfigureUART(void);
bool BSP_TestPinUartChecker(void);

/*** Used in hardware test ****/
void InitializeDigitalPinsNoPull(void);
void InitializeDigitalPinsPull(void);

#ifdef __cplusplus
}
#endif

#endif /* __BSP_SUPPORT_H__ */
```

## include/CborBuilder.h
```c
/******************************************************************************/
//! @file CborBuider.h
//! @brief 
//!
//! Copyright (c) 2020 Laird Connectivity
//! All Rights Reserved.
/******************************************************************************/

#ifndef CBOR_BUILDER_H
#define CBOR_BUILDER_H

#ifdef __cplusplus
extern "C" {
#endif

/******************************************************************************/
/* Includes                                                                   */
/******************************************************************************/
#include "FrameworkIncludes.h"

/******************************************************************************/
/* Global Constants, Macros and Type Definitions                              */
/******************************************************************************/
#define JSON_RPC_VERSION_STR  "2.0"

/******************************************************************************/
/* Global Data Definitions                                                    */
/******************************************************************************/

/******************************************************************************/
/* Global Function Prototypes                                                 */
/******************************************************************************/

//-----------------------------------------------
//! @brief  Starts a new JSON message with given ID.
//!
void CborBuilder_Start(UartMsg_t *pMsg, uint32_t Id);

//-----------------------------------------------
//! @brief  Starts a new JSON message without and Id (a notification)
//!
void CborBuilder_StartNotification(UartMsg_t *pMsg);

//-----------------------------------------------
//! @brief  Finalizes a JSON message with "result:"ok". Sets wasValid to true.
//!
void CborBuilder_FinalizeOk(UartMsg_t *pJsonMsg);

//-----------------------------------------------
//! @brief  Finalizes a JSON message with "result":<Value>. Sets wasValid to true.
//!
void CborBuilder_FinalizeIntegerResult(UartMsg_t *pJsonMsg, uint32_t Value);

//-----------------------------------------------
//! @brief  Finalizes a JSON message with "result":[Size,"base 64 data"]. 
//! Sets wasValid to true.
//!
void CborBuilder_FinalizeBase64Result(UartMsg_t *pJsonMsg, void *pData,
				      uint32_t Size);

//-----------------------------------------------
//! @brief  Finalizes a JSON message with the error object.  Sets wasValid to false.
//!    
void CborBuilder_FinalizeError(UartMsg_t *pJsonMsg, uint32_t Code,
			       char *pString);

//-----------------------------------------------
//! @brief  Adds a JSON pair to the message being built.
//!
//! @param  pKey, pValue  "<pKey>" : pValue
//!
//! @param  IsNotString is true when the value isn't a string.  This is used to properly format
//!         the output.  For example, "value:"string" or "value:1.
//!
void CborBuilder_AddPair(UartMsg_t *pJsonMsg, char *pKey, char *pValue,
			 bool IsNotString);

#ifdef __cplusplus
}
#endif

#endif

// end
```

## include/ControlTask.h
```c
/******************************************************************************/
//! @file ControlTask.h
//!
//! @brief 
//!
//! @copyright Copyright 2019 Laird
//!            All Rights Reserved.
/******************************************************************************/

#ifndef CONTROL_TASK_H
#define CONTROL_TASK_H

//EXTERN_C_BEGIN

/******************************************************************************/
/* Global Constants, Macros and Type Definitions                              */
/******************************************************************************/

//! The main thread can either have a stack large enough to do initialization, or
//! the control thread can be the "main" thread, or
//!
#ifndef CONTROL_TASK_USES_MAIN_THREAD
#define CONTROL_TASK_USES_MAIN_THREAD 1
#endif

/******************************************************************************/
/* Global Data Definitions                                                    */
/******************************************************************************/
// NA

/******************************************************************************/
/* Global Function Prototypes                                                 */
/******************************************************************************/

//-----------------------------------------------
//!
void ControlTask_Initialize(void);

//-----------------------------------------------
//! If CONTROL_TASK_USES_MAIN_THREAD is non-zero then this needs to part of main.
//!
void ControlTask_Thread(void);

//EXTERN_C_END

#endif

// end
```

## include/Framework.h
```c
/**
 * @file Framework.h
 * @brief Message Framework for intertask communication.
 *
 * Copyright (c) 2020 Laird Connectivity
 *
 * SPDX-License-Identifier: Apache-2.0
 */
#ifndef __FRAMEWORK_H__
#define __FRAMEWORK_H__

#ifdef __cplusplus
extern "C" {
#endif

/******************************************************************************/
/* Includes                                                                   */
/******************************************************************************/
#include <sys/util.h>
#include <zephyr/types.h>
#include <kernel.h>

#include "FrameworkIds.h"
#include "FrameworkMsgCodes.h"
#include "FrameworkMsgConfiguration.h"
#include "FrameworkMsgTypes.h"
#include "FrameworkMsg.h"
#include "FrameworkMacros.h"
#include "BufferPool.h"

/******************************************************************************/
/* Readability                                                                */
/******************************************************************************/
#define EXTERNED
#define PROTOTYPE_FOR_EXTERNED

/******************************************************************************/
/* Prevent unused x warnings                                                  */
/******************************************************************************/
#define UNUSED_VARIABLE(X) ((void)(X))
#define UNUSED_PARAMETER(X) UNUSED_VARIABLE(X)
#define UNUSED_RETURN_VALUE(X) UNUSED_VARIABLE(X)

/******************************************************************************/
/* Common                                                                     */
/******************************************************************************/
#ifndef NULL
#define NULL ((void *)0)
#endif

#ifndef NUL
#define NUL ('\0')
#endif

#ifndef MIN
#define MIN(a, b) ((a) < (b) ? (a) : (b))
#endif

#ifndef MAX
#define MAX(a, b) ((a) < (b) ? (b) : (a))
#endif

/******************************************************************************/
/* Framework Default Configuration                                            */
/******************************************************************************/
#ifndef FWK_DEBUG
#define FWK_DEBUG 0
#endif

#ifndef FWK_ASSERT_ENABLED
#define FWK_ASSERT_ENABLED 1
#endif

#ifndef FWK_USES_ZEPHYR_ASSERT
#define FWK_USES_ZEPHYR_ASSERT 0
#endif

#ifndef FWK_ALLOW_BROADCAST_FROM_ISR
#define FWK_ALLOW_BROADCAST_FROM_ISR 0
#endif

#define FWK_DEFAULT_RESET_DELAY_MS 5000

#define PERIODIC_TIMER_IS_ONE_SHOT 0

/******************************************************************************/
/* Global Constants, Macros and Type Definitions                              */
/******************************************************************************/
/* Zephyr kernel queue functions use int and return 0 for success */
#define BaseType_t int

/* Zephyr kernel time base is ms, @ref K_NO_WAIT, @ref K_FOREVER
 * It is unclear why this is signed. */
#define TickType_t s32_t

typedef enum FwkStatusEnum { FWK_SUCCESS = 0, FWK_ERROR } FwkStatus_t;

typedef enum DispatchResultEnum {
	DISPATCH_OK = 0,
	DISPATCH_ERROR,
	DISPATCH_DO_NOT_FREE,
} DispatchResult_t;

/*
 * Each message task has a message handler or dispatcher.
 * The dispatcher should be enabled using a case statement
 * so that the number of messages doesn't
 * affect the time to determine what handler to call.
 */
typedef struct FwkMsgReceiver FwkMsgReceiver_t;
typedef DispatchResult_t (*FwkMsgHandler_t)(FwkMsgReceiver_t *pMsgRxer,
					    FwkMsg_t *pMsg);

/*
 * Message Framework Receiver Object
 *
 * The dispatcher determines what function should handle each message.
 */
typedef struct k_msgq FwkQueue_t;

struct FwkMsgReceiver {
	FwkId_t id;
	FwkQueue_t *pQueue;
	TickType_t rxBlockTicks;
	FwkMsgHandler_t (*pMsgDispatcher)(FwkMsgCode_t msgCode);
};

/**
 * @brief Message Framework Task Object
 *
 * Contains a receiver object, task/thread information, and a timer
 */
typedef struct FwkMsgTask {	
	void * pContainer;           /* Object pointer that is returned in callbacks*/
	FwkMsgReceiver_t rxer;
	struct k_thread threadData;
	struct k_thread *pTid;
	struct k_timer timer;
	TickType_t timerDurationTicks; /* Initial time */
	TickType_t timerPeriodTicks; /* Second time (0 for one shot) */
} FwkMsgTask_t;

/**
 * @brief Get pointer to object containing task (in dispatcher context).
 *
 * Example:
 * DispatchResult_t MsgHandler(FwkMsgReceiver_t *pMsgRxer, FwkMsg_t *pMsg)
 * {
 *   TaskObj_t *pObj = FWK_TASK_CONTAINER(TaskObj_t);
 * }
 */
#define FWK_TASK_CONTAINER(_obj_)                                              \
	CONTAINER_OF(CONTAINER_OF(pMsgRxer, FwkMsgTask_t, rxer), _obj_, msgTask)

/******************************************************************************/
/* Global Function Prototypes                                                 */
/******************************************************************************/
/**
 * @brief This function initializes the Message Fwk registry and
 * buffer pool.
 */
void Framework_Initialize(void);

/**
 * @brief This function registers a Message Task or Receiver with the
 * Message Framework.  This is necessary to support routing of
 * messages. A critical section is entered when a task is
 * registered.  However, the task should be registered before the
 * task is created so that the periodic timer can be created before
 * the task starts.
 *
 * @param pMsgRxer A message receiver.
 * @param pMsgTask Pointer to a Message Task (which contains a rxer).
 *
 * Messages can be routed based on their ID or based on whether or not
 * they have a function mapped to a message code in their dispatcher.
 *
 * @ref FwkTaskIds.h
 */
void Framework_RegisterReceiver(FwkMsgReceiver_t *pRxer);
void Framework_RegisterTask(FwkMsgTask_t *pMsgTask);

/**
 * @brief Wraps the queue receive function of the OS and waits for
 * rxBlockTicks for a message to arrive in a task's queue.
 * When a message is received the appropriate message handler
 * function is called by the dispatcher.
 */
void Framework_MsgReceiver(FwkMsgReceiver_t *pMsgRxer);

/**
 * @brief Sends a message to a single task based on a task ID.
 *
 * @retval An assert isn't generated if RxId is invalid.
 * @note Caller is responsible for freeing memory, if status isn't success.
 */
BaseType_t Framework_Send(FwkId_t RxId, FwkMsg_t *pMsg);

/**
 * @brief Sends a single message to a single task by searching the
 * dispatcher of each message receiver.
 *
 * @note Prevents indirect coupling of tasks by message IDs.
 * @note This should not be used for messages that can go to more than
 * one destination.
 * @note As the number of tasks increases, the amount of time to find the
 * rxID increases.
 *
 * @retval Caller is responsible for freeing memory, if status isn't success.
 */
BaseType_t Framework_Unicast(FwkMsg_t *pMsg);

/**
 * @brief Copies a message and sends it to all tasks that have the message
 * code in their dispatcher.
 *
 * @param MsgSize required to copy message.
 *
 * @note Currently an assertion fires if this is called in interrupt context.
 *
 * @retval Caller is responsible for freeing memory, if status isn't success.
 */
BaseType_t Framework_Broadcast(FwkMsg_t *pMsg, size_t MsgSize);

/**
 * @brief Bypasses message router and puts a message directly on a queue.
 *
 * @note Most commonly used by a task to send a message to itself.
 */
BaseType_t Framework_Queue(FwkQueue_t *pQueue, void *ppData,
			   TickType_t BlockTicks);

/**
 * @retval 0 if not not empty
 */
BaseType_t Framework_QueueIsEmpty(FwkId_t RxId);

/**
 * @brief Free all messages in a receiver's queue.
 *
 * @retval Number of messages that were purged.
 */
size_t Framework_Flush(FwkId_t RxId);

/**
 * @brief Blocks on queue waiting for a message.
 *
 * @note If the caller checks that *ppData is not NULL
 * (without checking return), then it must initialize *ppData.
 * Example:
 * FwkMsg_t *pMsg = NULL;
 * Framework_Receive(q, &pMsg, 0);
 * if (pMsg != NULL) { ...
 *
 * @note Only needed in special cases.
 * This function is called by Framework_MsgReceiver.
 */
BaseType_t Framework_Receive(FwkQueue_t *pQueue, void *ppData,
			     TickType_t BlockTicks);
/**
 * @brief Starts a task's periodic timer
 */
void Framework_StartTimer(FwkMsgTask_t *pMsgTask);

/**
 * @brief Stops a task's periodic timer.
 */
void Framework_StopTimer(FwkMsgTask_t *pMsgTask);

/**
 *@brief Changes the period of a task's periodic timer.
 */
void Framework_ChangeTimerPeriod(FwkMsgTask_t *pMsgTask, TickType_t Duration,
				 TickType_t Period);

/******************************************************************************/
/* Define in application or weak implementation will be used.                 */
/******************************************************************************/
extern void Framework_AssertionHandler(char *file, int line);
extern bool Framework_InterruptContext(void);
extern void Framework_SystemReset(void);
extern DispatchResult_t Framework_UnknownMsgHandler(FwkMsgReceiver_t *pMsgRxer,
						    FwkMsg_t *pMsg);

/******************************************************************************/
/* Framework Assertions                                                       */
/******************************************************************************/
/* clang-format off */
#if FWK_USES_ZEPHYR_ASSERT
	#define FRAMEWORK_ASSERT(expr) __ASSERT(expr, "Framwork Assertion")
#elif FWK_ASSERT_ENABLED
	/* Shortened file names make it easier to support assertions that
	 * print the file name on processors with limited flash space. */
	#ifndef FNAME
		#ifndef FWK_FNAME
			#define FNAME __FILE__
		#else
			#define FNAME FWK_FNAME
		#endif
	#endif

	#define FRAMEWORK_ASSERT(expr) do { \
		if( !(expr) ) { Framework_AssertionHandler(FNAME, __LINE__); } \
	}while(0)
#else
	#define FRAMEWORK_ASSERT(expr)
#endif

/* Use a debug assert if you don't want the assert to reset the processor.
 * This is for backward compatibility.
 * Zephyr's __ASSERT_EVAL could be used instead.
 */
#if FWK_DEBUG
	#define FRAMEWORK_DEBUG_ASSERT(expr) FRAMEWORK_ASSERT(expr)
#else
	#define FRAMEWORK_DEBUG_ASSERT(expr)
#endif

/* Force an assertion to fire */
#define FORCED 0

/* clang-format on */

#ifdef __cplusplus
}
#endif

#endif /* __FRAMEWORK_H__ */
```

## include/LairdAdvFormat.h
```c
/******************************************************************************/
//!
//! @file LairdAdvFormat.h
//!
//! @brief Format Specifiers for the Manufacturer Specific Data Type
//!
//! Copyright (c) 2020 Laird Connectivity
//! All Rights Reserved.
/******************************************************************************/

#ifndef LAIRD_ADV_FORMAT_H
#define LAIRD_ADV_FORMAT_H

#ifdef __cplusplus
extern "C" {
#endif

/******************************************************************************/
/* Includes                                                                   */
/******************************************************************************/
#include <stdint.h>

/******************************************************************************/
/* Global Constants, Macros and Type Definitions                              */
/******************************************************************************/

#define LAIRD_CONNECTIVITY 0x0077
#define LAIRD_COMPANY_ID2 0x00E4

#define LAIRD_ADV_PROTOCOL_ID_RESERVED          0x0000
#define LAIRD_ADV_PROTOCOL_ID_SENTRIUS          0x0001
#define LAIRD_ADV_PROTOCOL_ID_SENTRIUS_EXTENDED 0x0002
#define LAIRD_ADV_PROTOCOL_ID_SENTRIUS_SCAN_RSP 0x0003

#define LAIRD_PRODUCT_ID_RESERVED 0x0000
#define LAIRD_PRODUCT_ID          0x0000

#define LAIRD_ADV_FORMAT_HW_VERSION(major, minor) ((uint8_t)(((((uint32_t)(major)) << 3) & 0x000000F8) | \
                                                   ((((uint32_t)(minor)) << 0 ) & 0x00000007))

#define LAIRD_ADV_PROTOCOL_FIRMWARE_TYPE_BT510        0x00

/******************************************************************************/
/* Global Data Definitions                                                    */
/******************************************************************************/

/******************************************************************************/
/* Global Function Prototypes                                                 */
/******************************************************************************/

#ifdef __cplusplus
}
#endif

#endif

// end
```

## include/ProtocolTask.h
```c
/**
 * @file ProtocolTask.h
 * @brief
 *
 * Copyright (c) 2020 Laird Connectivity
 *
 * SPDX-License-Identifier: Apache-2.0
 */
#ifndef __PROTOCOL_TASK_H__
#define __PROTOCOL_TASK_H__

/* (Remove Empty Sections) */
/******************************************************************************/
/* Includes                                                                   */
/******************************************************************************/
#include <zephyr/types.h>
#include <stddef.h>

#ifdef __cplusplus
extern "C" {
#endif

/******************************************************************************/
/* Global Constants, Macros and Type Definitions                              */
/******************************************************************************/

/******************************************************************************/
/* Global Data Definitions                                                    */
/******************************************************************************/

/******************************************************************************/
/* Global Function Prototypes                                                 */
/******************************************************************************/
/**
 * @brief
 *  The setup of the thread parameters
 * @param
 * @param
 *
 * @retval
 */
void ProtocolTask_Initialize(void);


#ifdef __cplusplus
}
#endif

#endif /* __PROTOCOL_TASK_H__ */
```
